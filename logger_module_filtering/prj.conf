## CMakeLists.txt
```
# Set up our own Kconfig options with a custom KCONFIG_ROOT.
#
# IMPORTANT: this must come before including boilerplate.cmake.
set(KCONFIG_ROOT ${CMAKE_CURRENT_SOURCE_DIR}/Kconfig)

include($ENV{ZEPHYR_BASE}/cmake/app/boilerplate.cmake NO_POLICY_SCOPE)
project(NONE)

target_sources(app PRIVATE src/main.c)
target_sources(app PRIVATE src/module_main_file.c)
target_sources(app PRIVATE src/module_helper_file.c)
```

## Kconfig
```
mainmenu "logger_module_filtering"

source "$ZEPHYR_BASE/Kconfig.zephyr"

config FOUNDRIES_IO_MOD_LOG_LEVEL
	int "Logger verbosity level for example module"
	range 0 4
	default 0
	help
	  This value controls the verbosity level for the example
	  Logger module in this application. The levels are:
	  - 0: NONE, disable module's logs (default)
	  - 1: ERR, only log errors
	  - 2: WRN, log warnings and errors
	  - 3: INF, log informational messages, warnings, and errors
	  - 4: DBG, enable all logs, even verbose debug messages
```

## prj.conf
```kconfig
CONFIG_LOG=y
# The "foundries_io_mod" logger module level is set to "debug"
# (numeric level 4) here. You can change this value and rebuild to
# alter the compile-time module filtering.
#
# For example, set to 1 for "info", and 0 for no logs.
CONFIG_FOUNDRIES_IO_MOD_LOG_LEVEL=4
```

## src/main.c
```c
/*
 * Copyright (c) 2018 Foundries.io
 *
 * SPDX-License-Identifier: Apache-2.0
 */

#include "module.h"

void main(void)
{
	module_init();
}
```

## src/module.h
```c
/*
 * Copyright (c) 2018 Foundries.io
 *
 * SPDX-License-Identifier: Apache-2.0
 */

#ifndef LOGGER_MODULE_FILTERING_MODULE_H
#define LOGGER_MODULE_FILTERING_MODULE_H

void module_init(void);
void module_get_help(void);

#endif
```

## src/module_helper_file.c
```c
#define LOG_LEVEL CONFIG_FOUNDRIES_IO_MOD_LOG_LEVEL
#define LOG_MODULE_NAME foundries_io_mod
#include <logging/log.h>

/*
 * Note LOG_MODULE_DECLARE() is used instead of LOG_MODULE_REGISTER().
 * Exactly one file registers the module. The other files in the
 * module still need to declare module-specific state before using
 * logger APIs.
 */
LOG_MODULE_DECLARE();

void module_get_help()
{
	LOG_DBG("i'm trying to help!");
}
```

## src/module_main_file.c
```c
#include "module.h"

#define LOG_LEVEL CONFIG_FOUNDRIES_IO_MOD_LOG_LEVEL
#define LOG_MODULE_NAME foundries_io_mod
#include <logging/log.h>
LOG_MODULE_REGISTER();

void module_init(void)
{
	LOG_INF("initialized; getting help.");
	module_get_help();
}
```
